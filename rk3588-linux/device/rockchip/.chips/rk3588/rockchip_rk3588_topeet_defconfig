## rk3588-linux/kernel/drivers/iio/imu/bmi270/Kconfig
```kconfig
# SPDX-License-Identifier: GPL-2.0
#
# BMI270 IMU driver
#

config BMI270
	tristate

config BMI270_I2C
	tristate "Bosch BMI270 I2C driver"
	depends on I2C
	select BMI270
	help
	  Enable support for the Bosch BMI270 6-axis IMU connected over I2C.
	  The driver exposes accelerometer, gyroscope and temperature channels
	  through the IIO subsystem.

	  This driver can also be built as a module. If so, the module will be
	  called bmi270_i2c.
```
